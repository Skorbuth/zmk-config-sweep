## config/west.yml
```yaml
manifest:
  remotes:
    - name: zmkfirmware
      url-base: https://github.com/zmkfirmware
    - name: Skorbuth
      url-base: https://github.com/Skorbuth
  projects:
    - name: zmk
      remote: Skorbuth
      revision: main
      import: app/west.yml
  self:
    path: config
```
